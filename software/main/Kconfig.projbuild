## software/main/Kconfig.projbuild
```kconfig
menu "QUTEE settings"

    config MICRO_ROS_APP_STACK
        int "Stack the micro-ROS app (Bytes)"
        default 16000
        help
        Stack size in Bytes of the micro-ROS app

    config MICRO_ROS_APP_TASK_PRIO
        int "Priority of the micro-ROS app"
        default 1
        help
        Priority of micro-ros task higher value means higher priority

    config ROBOT_CTRL_APP_STACK
        int "Stack the Robot Controll app (Bytes)"
        default 16000
        help
        Stack size in Bytes of the Robot Controll app

    config ROBOT_CTRL_APP_TASK_PRIO
        int "Priority of the Robot Controll app"
        default 10
        help
        Priority of  Robot Controll task higher value means higher priority

    config NB_HIDDEN_LAYERS 
        int "Number of Hidden Layers in the neural network"
        default 1
        help
        Number of Hidden Layers in the neural network


    config NB_NEURONS_PER_LAYER
        int "Number of neuron per hidden layer"
        default 10
        help
        Number of neuron per hidden layer. Every hidden layer has the same size. 
    config QUTEE_NAME
        string "Name of the Qutee robot"
        default "qutee"
        help
        Name of the Qutee robot. Useful if multiple robots are used. This is used as prefix for the ROS2 topic/service names. 
        
    config CONTROL_FREQUENCY
        int "Control freqency for the Qutee, in Hz"
        default 50
        help
        Control freqency for the Qutee

    config EPISODE_DURATION
        int "Duration of an episode in seconds"
        default 5
        help
        Duration of an episode
    
    
endmenu
```
